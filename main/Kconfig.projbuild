## main/Kconfig.projbuild
```kconfig
menu "HydroTemp"

    config APP_I2C_SDA_GPIO
        int "OLED I2C SDA GPIO"
        default 22

    config APP_I2C_SCL_GPIO
        int "OLED I2C SCL GPIO"
        default 21

    config APP_OLED_FLIP
        bool "Rotate the OLED by 180 degrees"
        default y

    config APP_ONEWIRE_GPIO
        int "DS18B20 1-Wire data GPIO"
        default 4

    config APP_SENSOR_VCC_GPIO
        int "GPIO that powers the sensors (driven high), -1 for none"
        default 16

    config APP_SENSOR_GND_GPIO
        int "GPIO that grounds the sensors (driven low), -1 for none"
        default 2

endmenu
```

## sdkconfig.defaults
```kconfig
CONFIG_IDF_TARGET="esp32"
CONFIG_ESPTOOLPY_FLASHSIZE_4MB=y
CONFIG_ESPTOOLPY_FLASHMODE_DIO=y
CONFIG_ESPTOOLPY_FLASHFREQ_40M=y

CONFIG_ESP_CONSOLE_UART_DEFAULT=y
CONFIG_ESP_CONSOLE_UART_NUM=0
CONFIG_ESP_CONSOLE_UART_BAUDRATE=115200

CONFIG_FREERTOS_HZ=1000

CONFIG_LWIP_NETIF_LOOPBACK=y

CONFIG_PARTITION_TABLE_CUSTOM=y
CONFIG_PARTITION_TABLE_CUSTOM_FILENAME="partitions.csv"

CONFIG_ESP_WIFI_NVS_ENABLED=n

# For the "skip certificate verification" MQTT option.
CONFIG_ESP_TLS_INSECURE=y
CONFIG_ESP_TLS_SKIP_SERVER_CERT_VERIFY=y

CONFIG_MBEDTLS_CERTIFICATE_BUNDLE=y

CONFIG_LWIP_MAX_SOCKETS=32

CONFIG_HTTPD_MAX_REQ_HDR_LEN=2048

CONFIG_ESP_MAIN_TASK_STACK_SIZE=8192
```
